/dts-v1/;
/plugin/;

/* 64 MiB at the top of the validated 14 GiB DDR_HIGH region.
 * DDR_HIGH: 0x8_0000_0000 .. 0xb_7fff_ffff
 * Arena:    0xb_7c00_0000 .. 0xb_7fff_ffff
 */
/ {
    compatible = "xlnx,zynqmp";

    fragment@0 {
        target-path = "/reserved-memory";
        __overlay__ {
            #address-cells = <2>;
            #size-cells = <2>;

            q8q8_dma: q8q8-dma@b7c000000 {
                compatible = "shared-dma-pool";
                no-map;
                reg = <0x0000000b 0x7c000000 0x00000000 0x04000000>;
            };
        };
    };

    fragment@1 {
        target-path = "/";
        __overlay__ {
            #address-cells = <2>;
            #size-cells = <2>;

            q8q8_gemm_uio: q8q8-gemm@a0000000 {
                compatible = "generic-uio";
                linux,uio-name = "q8q8-gemm";
                reg = <0x00000000 0xa0000000 0x00000000 0x00010000>,
                      <0x0000000b 0x7c000000 0x00000000 0x04000000>;
                reg-names = "control", "dma";
                status = "okay";
            };
        };
    };
};
